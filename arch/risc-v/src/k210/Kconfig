## arch/risc-v/src/k210/Kconfig
```kconfig
#
# For a description of the syntax of this configuration file,
# see the file kconfig-language.txt in the NuttX tools repository.
#

comment "K210 Configuration Options"

menu "K210 Peripheral Support"

# These "hidden" settings determine whether a peripheral option is available
# for the selected MCU

config K210_HAVE_UART0
	bool
	default y
	select UART0_SERIALDRIVER
	select ARCH_HAVE_SERIAL_TERMIOS

# These are the peripheral selections proper

config K210_UART0
	bool "UART0"
	default y
	select ARCH_HAVE_UART0
	select ARCH_HAVE_SERIAL_TERMIOS
	select K210_UART

config K210_I2C
	bool "I2C"
	default n

config K210_I2C0
	bool "I2C0"
	default n
	select K210_I2C

endmenu

menu "K210 Others"

config K210_WITH_QEMU
	bool "qemu support"
	default n

endmenu
```
